## board/pbinkowski/sbc030/Kconfig
```kconfig
if TARGET_SBC030

config SYS_CPU
	default "mc680x0"

config SYS_BOARD
	default "sbc030"

config SYS_VENDOR
	default "pbinkowski"

config SYS_CONFIG_NAME
	default "SBC030"

endif
```

## configs/SBC030_defconfig
```kconfig
CONFIG_M68K=y
CONFIG_SYS_TEXT_BASE=0x07F00000
CONFIG_TARGET_SBC030=y
# CONFIG_CC_OPTIMIZE_FOR_SIZE is not set
CONFIG_NR_DRAM_BANKS=1
# CONFIG_SYS_MALLOC_CLEAR_ON_INIT is not set
# CONFIG_ARCH_FIXUP_FDT_MEMORY is not set
CONFIG_LOGLEVEL=8
CONFIG_BOARD_LATE_INIT=y
CONFIG_HUSH_PARSER=y
CONFIG_SYS_PROMPT="> "
# CONFIG_CMD_BOOTD is not set
CONFIG_CMD_BOOT68=y
# CONFIG_CMD_ELF is not set
# CONFIG_CMD_IMI is not set
# CONFIG_CMD_XIMG is not set
# CONFIG_CMD_EXPORTENV is not set
# CONFIG_CMD_IMPORTENV is not set
# CONFIG_CMD_EDITENV is not set
# CONFIG_CMD_ENV_EXISTS is not set
# CONFIG_CMD_CRC32 is not set
# CONFIG_CMD_FLASH is not set
# CONFIG_CMD_LOADB is not set
# CONFIG_CMD_LOADS is not set
CONFIG_CMD_MMC=y
CONFIG_CMD_MTD=y
CONFIG_CMD_MMC_SPI=y
# CONFIG_CMD_SOURCE is not set
CONFIG_CMD_DHCP=y
# CONFIG_BOOTP_BOOTPATH is not set
# CONFIG_BOOTP_DNS is not set
# CONFIG_BOOTP_GATEWAY is not set
# CONFIG_BOOTP_HOSTNAME is not set
# CONFIG_BOOTP_SUBNETMASK is not set
# CONFIG_CMD_NFS is not set
CONFIG_CMD_TIME=y
# CONFIG_CMD_MISC is not set
CONFIG_CMD_EXT2=y
CONFIG_DOS_PARTITION=y
CONFIG_ENV_IS_IN_EXT4=y
CONFIG_ENV_EXT4_INTERFACE="mmc"
CONFIG_ENV_EXT4_DEVICE_AND_PART="0:1"
CONFIG_NET_RANDOM_ETHADDR=y
CONFIG_MMC=y
# CONFIG_MMC_WRITE is not set
# CONFIG_MMC_QUIRKS is not set
# CONFIG_MMC_HW_PARTITIONING is not set
CONFIG_MTD_NOR_FLASH=y
CONFIG_FLASH_CFI_DRIVER=y
CONFIG_FLASH_CFI_MTD=y
CONFIG_SPI_FLASH=y
CONFIG_SPI_FLASH_WINBOND=y
# CONFIG_SPI_FLASH_USE_4K_SECTORS is not set
CONFIG_SPI_FLASH_MTD=y
CONFIG_ENC28J60=y
CONFIG_SPI=y
CONFIG_SBC030_SPI=y
CONFIG_CC_OPTIMIZE_LIBS_FOR_SPEED=y
# CONFIG_REGEX is not set
CONFIG_LZO=y
```
